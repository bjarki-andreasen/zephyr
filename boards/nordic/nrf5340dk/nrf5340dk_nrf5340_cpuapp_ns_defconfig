## drivers/clock_management/nrf/Kconfig
```kconfig
# SPDX-FileCopyrightText: Copyright 2026 Nordic Semiconductor ASA
# SPDX-License-Identifier: Apache-2.0

config CLOCK_MANAGEMENT_NRF
	bool

config CLOCK_MANAGEMENT_NRF_FIXED_FACTOR
	bool "nRF Fixed factor clock driver"
	default y
	depends on DT_HAS_NORDIC_NRF_FIXED_FACTOR_ENABLED
	select CLOCK_MANAGEMENT_NRF

config CLOCK_MANAGEMENT_NRF_HFPLL_MUX
	bool "nRF HFPLL mux clock driver"
	default y
	depends on DT_HAS_NORDIC_NRF_HFPLL_MUX_ENABLED
	select CLOCK_MANAGEMENT_NRF
	select NRFX_CLOCK_XO

config CLOCK_MANAGEMENT_NRF_LFCLK_MUX
	bool "nRF LFCLK mux clock driver"
	default y
	depends on DT_HAS_NORDIC_NRF_LFCLK_MUX_ENABLED
	select CLOCK_MANAGEMENT_NRF
	select NRFX_CLOCK_LFCLK
```

## dts/bindings/clock-management/nrf/nordic,nrf-fixed-factor.yaml
```yaml
# Copyright 2026 Nordic Semiconductor ASA
# SPDX-License-Identifier: Apache-2.0

compatible: "nordic,nrf-fixed-factor"

description: Nordic nRF fixed factor clock driver

include: [clock-node.yaml]

properties:
  input:
    type: phandle
    required: true
    description: Clock node that is the input to this divider

  divider:
    type: int
    description: The fixed divider value

  multiplier:
    type: int
    description: The fixed multiplier value

  "#clock-cells":
    const: 0
```

## dts/bindings/clock-management/nrf/nordic,nrf-hfclkcore.yaml
```yaml
# Copyright 2026 Nordic Semiconductor ASA
# SPDX-License-Identifier: Apache-2.0

compatible: "nordic,nrf-hfclkcore"

description: Nordic nRF HFCLKCORE clock driver

include: [clock-node.yaml]

properties:
  input:
    type: phandle
    required: true
    description: Clock node that is the input to this divider

  "#clock-cells":
    const: 0
```

## dts/bindings/clock-management/nrf/nordic,nrf-hfpll-mux.yaml
```yaml
# Copyright 2026 Nordic Semiconductor ASA
# SPDX-License-Identifier: Apache-2.0

compatible: "nordic,nrf-hfpll-mux"

description: Nordic nRF HFPLL multiplexer

include: [clock-node.yaml]

properties:
  input-sources:
    type: phandles
    required: true
    description: |
      List of all input sources provided to the multiplexer. These sources
      should be references to other clock nodes within the clock tree.

  "#clock-cells":
    const: 1

clock-cells:
  - mux
```

## dts/bindings/clock-management/nrf/nordic,nrf-lfclk-mux.yaml
```yaml
# Copyright 2026 Nordic Semiconductor ASA
# SPDX-License-Identifier: Apache-2.0

compatible: "nordic,nrf-lfclk-mux"

description: Nordic nRF LFCLK clock mux

include: [clock-node.yaml]

properties:
  input-sources:
    type: phandles
    required: true
    description: |
      List of all input sources provided to the multiplexer. These sources
      should be references to other clock nodes within the clock tree.

  "#clock-cells":
    const: 1

clock-cells:
  - mux
```

## dts/bindings/test/vnd,clock-device.yaml
```yaml
# SPDX-FileCopyrightText: Copyright 2026 Nordic Semiconductor ASA
# SPDX-License-Identifier: Apache-2.0

description: Test clock device

compatible: vnd,clock-device

include: clock-device.yaml
```

## soc/nordic/common/Kconfig.tee
```kconfig
feature = REBOOT
rsource "Kconfig.tee_feature"

feature = POWEROFF
rsource "Kconfig.tee_feature"

feature = GPIO_PIN_MCU_SELECT
rsource "Kconfig.tee_feature"
```

## soc/nordic/common/Kconfig.tee_feature
```kconfig
choice "SOC_TEE_$(feature)"
	prompt "TEE implementation for $(feature)"
	default SOC_TEE_$(feature)_NATIVE

config SOC_TEE_$(feature)_NATIVE
	bool "Use native implementation of $(feature)"

config SOC_TEE_$(feature)_CUSTOM
	bool "Use hook for custom implementation of $(feature)"

config SOC_TEE_$(feature)_DISABLED
	bool "Exclude implementation of $(feature)"

endchoice
```
