## dts/bindings/arm/nordic,nrf-spu.yaml
```yaml
description: Nordic SPU (System Protection Unit)

compatible: "nordic,nrf-spu"

include: base.yaml

properties:
  reg:
    required: true

  interrupts:
    required: true

  "#periph-perm-cells":
    type: int
    const: 2

  "#feature-gpiote-ch-cells":
    type: int
    const: 3

  "#feature-gpiote-int":
    type: int
    const: 3

  "#feature-gpio-pin":
    type: int
    const: 3

periph-perm-cells:
  - n
  - value

feature-gpiote-ch-cells:
  - n
  - o
  - value

feature-gpiote-int-cells:
  - n
  - o
  - value

feature-gpio-pin-cells:
  - n
  - o
  - value
```

## tests/drivers/sensor/photosensor/testcase.yaml
```yaml
# Copyright (c) 2026 Nordic Semiconductor
# SPDX-License-Identifier: Apache-2.0

tests:
  drivers.sensor.photosensor:
    platform_allow:
      - native_sim
      - native_sim/native/64
    tags:
      - drivers
      - sensor
```
